## CMakeLists.txt
```
cmake_minimum_required(VERSION 3.20.0)

# ── ViewAlyzer module path ────────────────────────────────────────────
# Default assumes the standard ViewAlyzer repo layout:
#   ViewAlyzer/Example-Projects/zephyr/<this-project>/
#   ViewAlyzer/ViewAlyzerRecorder/
# Override on the command line if your layout differs:
#   west build -b nucleo_g474re . -- -DVIEWALYZER_MODULE_PATH=/path/to/ViewAlyzerRecorder
set(VIEWALYZER_MODULE_PATH
  "${CMAKE_CURRENT_SOURCE_DIR}/../../../ViewAlyzerRecorder"
  CACHE PATH "Path to the ViewAlyzerRecorder Zephyr module"
)

list(APPEND ZEPHYR_EXTRA_MODULES
  ${VIEWALYZER_MODULE_PATH}
)

find_package(Zephyr REQUIRED HINTS $ENV{ZEPHYR_BASE})
project(viewalyzer_helloworld)

target_sources(app PRIVATE
  src/main.c
)
```

## prj.conf
```kconfig
# Minimal "hello ViewAlyzer" config for nucleo_g474re over ITM/SWO.

# LED blink driver
CONFIG_GPIO=y

# Pull in a libc that provides sinf() for the demo trace
CONFIG_NEWLIB_LIBC=y

# Zephyr kernel features ViewAlyzer relies on
CONFIG_MULTITHREADING=y
CONFIG_THREAD_NAME=y
CONFIG_THREAD_MONITOR=y
CONFIG_THREAD_STACK_INFO=y

# ViewAlyzer module + tracing user hook (both required)
CONFIG_VIEWALYZER=y
CONFIG_TRACING_USER=y

# Transport: ITM/SWO. Host SWV start rate must match this frequency.
CONFIG_VIEWALYZER_TRANSPORT_ITM=y
CONFIG_VIEWALYZER_TRANSPORT_RTT=n
CONFIG_LOG_BACKEND_SWO=y
CONFIG_LOG_BACKEND_SWO_FREQ_HZ=2000000
CONFIG_STM32_ENABLE_DEBUG_SLEEP_STOP=y
```

## src/main.c
```c
/*
 * Smallest possible Zephyr + ViewAlyzer integration:
 *   - blinks the board LED
 *   - logs a slow sine wave as a single user trace so you can confirm
 *     the recorder is alive end-to-end in the desktop app
 *
 * Hardware: nucleo_g474re (ITM/SWO transport).
 */

#include <math.h>
#include <zephyr/kernel.h>
#include <zephyr/drivers/gpio.h>

#include "ViewAlyzer.h"
#include "VA_Adapter_Zephyr.h"

#define LED0_NODE DT_ALIAS(led0)
static const struct gpio_dt_spec led = GPIO_DT_SPEC_GET(LED0_NODE, gpios);

#define USER_TRACE_SINE   1
#define USER_TRACE_COUNTER  2
#define SAMPLE_PERIOD_MS  50    /* 100 samples per cycle */

static float simple_sine_wave(void)
{
    static float angle;
    float value = sinf(angle);
    angle += 0.0628f;           /* 2*pi / 100 */
    return value;
}

int main(void)
{
    if (!device_is_ready(led.port)) {
        return -1;
    }
    gpio_pin_configure_dt(&led, GPIO_OUTPUT_ACTIVE);

    k_msleep(1000);             /* let debugger attach before first sync */

    VA_Init(SystemCoreClock);
    VA_Zephyr_RegisterExistingThreads();
    VA_RegisterUserTrace(USER_TRACE_SINE, "Sine", VA_USER_TYPE_GRAPH);
    VA_RegisterUserTrace(USER_TRACE_COUNTER, "Counter", VA_USER_TYPE_COUNTER);
    while (1) {
        gpio_pin_toggle_dt(&led);
        VA_LogTraceFloat(USER_TRACE_SINE, simple_sine_wave());
        VA_LogTrace(USER_TRACE_COUNTER, k_uptime_get_32());
        k_msleep(SAMPLE_PERIOD_MS);
    }

    return 0;
}
```
