## Example-Projects/zephyr/STM32-Zephyr-VA-Module-Sample/boards/nucleo_f446re.conf
```kconfig
CONFIG_VIEWALYZER_TRANSPORT_ITM=n
CONFIG_VIEWALYZER_TRANSPORT_RTT=y
CONFIG_VIEWALYZER_RTT_CHANNEL=0
CONFIG_VIEWALYZER_CONFIGURE_RTT=y
CONFIG_VIEWALYZER_RTT_BUFFER_SIZE=10384
CONFIG_SEGGER_RTT_MODE_BLOCK_IF_FIFO_FULL=n
CONFIG_LOG_BACKEND_SWO=n
CONFIG_NO_OPTIMIZATIONS=n
```

## ViewAlyzerRecorder/zephyr/Kconfig
```kconfig
menuconfig VIEWALYZER
	bool "ViewAlyzer Trace Recorder"
	default n
	select TRACING
	select THREAD_MONITOR
	select THREAD_STACK_INFO
	select THREAD_NAME
	help
	  Enable the ViewAlyzer binary trace recorder for Zephyr.

if VIEWALYZER

choice VIEWALYZER_TRANSPORT
	prompt "Transport backend"
	default VIEWALYZER_TRANSPORT_ITM
	help
	  Select how the recorder sends trace data to the host.

config VIEWALYZER_TRANSPORT_ITM
	bool "ARM ITM / SWO"
	help
	  Send recorder data over the Cortex-M ITM stimulus port.

config VIEWALYZER_TRANSPORT_RTT
	bool "SEGGER RTT"
	select HAS_SEGGER_RTT
	select USE_SEGGER_RTT
	select STM32_ENABLE_DEBUG_SLEEP_STOP if SOC_FAMILY_STM32
	help
	  Send recorder data over SEGGER RTT.  Requires the Zephyr Segger module
	  (add 'segger' to the west manifest name-allowlist then run west update).

endchoice

config VIEWALYZER_TRACE_THREADS
	bool "Trace thread switches"
	default y
	select TRACING_THREAD

config VIEWALYZER_TRACE_ISRS
	bool "Trace ISRs"
	default y
	select TRACING_ISR

config VIEWALYZER_TRACE_MUTEXES
	bool "Trace mutexes"
	default y
	select TRACING_MUTEX

config VIEWALYZER_TRACE_SEMAPHORES
	bool "Trace semaphores"
	default y
	select TRACING_SEMAPHORE

config VIEWALYZER_TRACE_SLEEP
	bool "Trace thread sleep (k_sleep / k_msleep / k_usleep)"
	default y
	help
	  Emit enter/exit events when threads call k_sleep, k_msleep,
	  or k_usleep.  Allows the viewer to distinguish explicit sleep
	  from generic OS/idle time.

config VIEWALYZER_TRACE_TIMERS
	bool "Trace kernel timers (k_timer)"
	default y
	select TRACING_TIMER
	help
	  Emit init/start/stop events when threads create, arm, or cancel
	  kernel timers.  Allows the viewer to display timer lifecycle on
	  the event table and timeline.

config VIEWALYZER_TRACE_HEAPS
	bool "Trace kernel heaps (k_heap alloc/free)"
	default y
	select TRACING_HEAP
	help
	  Emit alloc/free events for kernel heaps.  Allows the viewer to
	  display allocation patterns, sizes, and potential memory leaks.

config VIEWALYZER_TRACE_PM
	bool "Trace power management suspend/resume"
	default y
	depends on PM
	help
	  Emit enter/exit events when the system enters or exits a low-power
	  state via pm_system_suspend.  Requires CONFIG_PM to be enabled.
	  Allows the viewer to display low-power periods in the event table
	  and timeline.

config VIEWALYZER_HEAP_RUNTIME_STATS
	bool "Send heap runtime statistics (allocated_bytes) in heap events"
	default y
	depends on VIEWALYZER_TRACE_HEAPS
	select SYS_HEAP_RUNTIME_STATS
	help
	  When enabled, each heap alloc/free trace event carries the current
	  total allocated_bytes from the Zephyr sys_heap runtime statistics
	  instead of just the individual request size.  This lets ViewAlyzer
	  show live heap usage, high-water marks, and inferred free sizes.
	  Adds a small overhead per alloc/free to query heap stats.

config VIEWALYZER_TRACE_MESSAGE_QUEUES
	bool "Trace message queues"
	default y
	select TRACING_MESSAGE_QUEUE

config VIEWALYZER_STACK_USAGE
	bool "Capture thread stack usage"
	default y
	select INIT_STACKS

config VIEWALYZER_MAX_SYNC_OBJECTS
	int "Max sync object slots"
	default 64
	help
	  Number of mutex, semaphore, and queue objects the recorder can track.

config VIEWALYZER_MAX_TASKS
	int "Max task slots"
	default 16
	help
	  Number of RTOS task or thread entries the recorder can track.

config VIEWALYZER_MAX_USER_FUNCTIONS
	int "Max user function slots"
	default 16
	help
	  Number of user-profiled function IDs the recorder can store.

config VIEWALYZER_MAX_TASK_NAME_LEN
	int "Max task name length"
	default 16
	range 4 255
	help
	  Maximum stored length for task, object, and user-function names.

config VIEWALYZER_ALLOW_DISABLE_INTERRUPTS
	bool "Allow interrupt masking in recorder critical sections"
	default y
	help
	  Allow the recorder to mask interrupts around short internal critical
	  sections. Disable this if the target environment must never disable
	  interrupts from inside the recorder.

config VIEWALYZER_RTT_CHANNEL
	int "RTT up-buffer channel"
	default 0
	range 0 15
	depends on VIEWALYZER_TRANSPORT_RTT
	help
	  SEGGER RTT up-buffer channel used by the recorder.

config VIEWALYZER_CONFIGURE_RTT
	bool "Configure the RTT up-buffer in VA_Init()"
	default y
	depends on VIEWALYZER_TRANSPORT_RTT
	help
	  Let the recorder call SEGGER_RTT_Init() and configure its RTT
	  up-buffer during initialization. Disable this if another component
	  owns RTT channel setup.

config VIEWALYZER_RTT_BUFFER_SIZE
	int "Recorder RTT buffer size"
	default 4096
	range 0 65535
	depends on VIEWALYZER_TRANSPORT_RTT && VIEWALYZER_CONFIGURE_RTT
	help
	  Size of the recorder-owned RTT up-buffer. Set to 0 to use the RTT
	  control block without providing a dedicated buffer.

config VIEWALYZER_AUTO_SETUP_INTERVAL_MS
	int "Auto setup bundle re-emit interval (ms)"
	default 2000
	range 0 60000
	help
	  Interval in milliseconds at which the recorder automatically
	  re-emits the sync marker and setup packets. This helps the host
	  application resync if it connects mid-session. Set to 0 to disable
	  automatic re-emission.

endif
```
